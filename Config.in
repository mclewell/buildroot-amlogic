## configs/odroidhc4_defconfig
```kconfig
BR2_aarch64=y
BR2_cortex_a55=y
BR2_TOOLCHAIN_EXTERNAL=y
BR2_SYSTEM_DHCP="eth0"
BR2_ROOTFS_OVERLAY="$(BR2_EXTERNAL_AMLOGIC_PATH)/board/odroidhc4/rootfs-overlay"
BR2_ROOTFS_POST_IMAGE_SCRIPT="$(BR2_EXTERNAL_AMLOGIC_PATH)/board/odroidhc4/post-image.sh"
BR2_LINUX_KERNEL=y
BR2_LINUX_KERNEL_CUSTOM_VERSION=y
BR2_LINUX_KERNEL_CUSTOM_VERSION_VALUE="5.15.24"
BR2_LINUX_KERNEL_USE_CUSTOM_CONFIG=y
BR2_LINUX_KERNEL_CUSTOM_CONFIG_FILE="$(BR2_EXTERNAL_AMLOGIC_PATH)/board/odroidhc4/linux.config"
BR2_LINUX_KERNEL_DTS_SUPPORT=y
BR2_LINUX_KERNEL_INTREE_DTS_NAME="amlogic/meson-sm1-odroid-hc4"
BR2_PACKAGE_LIBXML2=y
BR2_PACKAGE_LIBGLIB2=y
BR2_PACKAGE_NTP=y
BR2_PACKAGE_OPENSSH=y
# BR2_PACKAGE_OPENSSH_KEY_UTILS is not set
BR2_PACKAGE_UTIL_LINUX=y
BR2_PACKAGE_UTIL_LINUX_BINARIES=y
BR2_PACKAGE_UTIL_LINUX_MOUNT=y
BR2_PACKAGE_UTIL_LINUX_MOUNTPOINT=y
BR2_PACKAGE_UTIL_LINUX_PIVOT_ROOT=y
BR2_TARGET_ROOTFS_EXT2=y
BR2_TARGET_ROOTFS_EXT2_4=y
BR2_TARGET_ROOTFS_EXT2_SIZE="512M"
# BR2_TARGET_ROOTFS_TAR is not set
BR2_TARGET_UBOOT=y
BR2_TARGET_UBOOT_BUILD_SYSTEM_KCONFIG=y
BR2_TARGET_UBOOT_CUSTOM_VERSION=y
BR2_TARGET_UBOOT_CUSTOM_VERSION_VALUE="2022.01"
BR2_TARGET_UBOOT_BOARD_DEFCONFIG="odroid-hc4"
BR2_PACKAGE_HOST_GENIMAGE=y
BR2_PACKAGE_HOST_MTOOLS=y
BR2_PACKAGE_HOST_UBOOT_TOOLS=y
BR2_PACKAGE_HOST_UBOOT_TOOLS_FIT_SUPPORT=y
BR2_PACKAGE_HOST_UBOOT_TOOLS_FIT_SIGNATURE_SUPPORT=y
BR2_PACKAGE_HOST_UBOOT_TOOLS_BOOT_SCRIPT=y
BR2_PACKAGE_HOST_UBOOT_TOOLS_BOOT_SCRIPT_SOURCE="$(BR2_EXTERNAL_AMLOGIC_PATH)/board/odroidhc4/uboot-script.in"
BR2_PACKAGE_HOST_AMLOGIC_BOOT_FIP=y
BR2_PACKAGE_HOST_AMLOGIC_BOOT_FIP_ODROIDHC4=y
```

## package/amlogic-boot-fip/Config.in.host
```kconfig
config BR2_PACKAGE_HOST_AMLOGIC_BOOT_FIP
	bool "host Firmware Image Package for Amlogic"
	help
		Fimware Image Package (FIP) sources used to sign Amlogic U-Boot binaries.
		The selected board folders will be copied to ${HOST_DIR}/share/fip. The
		boot binary can then be assembled inside the post-image.sh

if BR2_PACKAGE_HOST_AMLOGIC_BOOT_FIP


config BR2_PACKAGE_HOST_AMLOGIC_BOOT_FIP_ODROIDC2
	bool "Odroid-C2"

config BR2_PACKAGE_HOST_AMLOGIC_BOOT_FIP_ODROIDC4
	bool "Odroid-C4"

config BR2_PACKAGE_HOST_AMLOGIC_BOOT_FIP_ODROIDHC4
	bool "Odroid-HC4"

config BR2_PACKAGE_HOST_AMLOGIC_BOOT_FIP_ODROIDN2
	bool "Odroid-N2"

config BR2_PACKAGE_HOST_AMLOGIC_BOOT_FIP_ODROIDN2PLUS
	bool "Odroid-N2+"

endif # BR2_PACKAGE_HOST_AMLOGIC_BOOT_FIP
```
